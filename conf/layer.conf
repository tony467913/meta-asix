## conf/layer.conf
```bitbake
# We have a conf and classes directory, add to BBPATH
BBPATH .= ":${LAYERDIR}"

# We have recipes-* directories, add to BBFILES
BBFILES += "${LAYERDIR}/recipes-*/*/*.bb \
            ${LAYERDIR}/recipes-*/*/*.bbappend"

BBFILE_COLLECTIONS += "meta-asix"
BBFILE_PATTERN_meta-asix = "^${LAYERDIR}/"
BBFILE_PRIORITY_meta-asix = "6"

LAYERDEPENDS_meta-asix = "core"
LAYERSERIES_COMPAT_meta-asix = "scarthgap"

IMAGE_INSTALL += " ax88179"
KERNEL_MODULE_AUTOLOAD += " ax88179"
```
